#include "ADC_task.h"
#include "cmsis_os.h"
#include "ProtocolConvert.h"


/*
----------------------------------------------------------------------------------------------

----------------------------------------------------------------------------------------------
*/
NTC_Info_t NTC_Info[NTC_Temp_Max];

/*
----------------------------------------------------------------------------------------------

----------------------------------------------------------------------------------------------
*/
NTC_Info_t* GetNTC_Info(NTC_Temp_e ntc)
{
    if(ntc >= NTC_Temp_Max)
        return NULL;

    return &NTC_Info[ntc];
}

/*
----------------------------------------------------------------------------------------------

----------------------------------------------------------------------------------------------
*/
int16_t Read_NTC_temp(uint8_t port)
{
    switch (port)
    {
    case 1:
        break;
    case 2:
        break;
    default:
        break;
    }

    return 0;
}
/*
----------------------------------------------------------------------------------------------

----------------------------------------------------------------------------------------------
*/
void NTC_Pro(uint8_t port)
{
    PortConfig_NTC_t* NTC = GetPortConfig_NTC(port);
    if(NTC == NULL)
        return;

    if(NTC->en == 0)
        return;

    NTC_Info_t* ntc_info = GetNTC_Info(NTC->temp);
    if(ntc_info == NULL)
        return;

    ntc_info->temp = Read_NTC_temp(port);
}

/*
----------------------------------------------------------------------------------------------

----------------------------------------------------------------------------------------------
*/
void ADC_Task(void)
{
    while(1)
    {
        uint32_t r_event = osEventFlagsWait(ADC_EventHandle, ADC_Event_Tick, osFlagsWaitAny, osWaitForever);

        if(r_event & ADC_Event_Tick)
        {

            for(uint8_t port = 1; port <= PortConfig_NTC_Num; port++)
            {
                NTC_Pro(port);
            }

            // printf("%s\r\n", __func__);
        }
    }
}

/*
----------------------------------------------------------------------------------------------

----------------------------------------------------------------------------------------------
*/



